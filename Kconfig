## Kconfig
```kconfig
mainmenu "cONNXr configuration"

menu "Operators"
source "src/operators/Kconfig"
endmenu

menu "Build options"
source "build.Kconfig"
endmenu
```

## src/operators/ai.onnx/Add/7/Kconfig
```kconfig
menuconfig HAVE_OPERATOR__AI_ONNX__ADD__7
	bool "7"
	help
		Enable domain 'ai.onnx' operator 'Add' version '7'
	default y
	if HAVE_OPERATOR__AI_ONNX__ADD__7
		rsource "*.Kconfig"
	endif
```

## src/operators/ai.onnx/Add/Kconfig
```kconfig
menuconfig HAVE_OPERATOR__AI_ONNX__ADD
	bool "Add"
	default y
	help
		Enable the domain 'ai.onnx' operator 'Add'
	if HAVE_OPERATOR__AI_ONNX__ADD
		rsource "*/Kconfig"
	endif
```

## src/operators/ai.onnx/ArgMax/12/Kconfig
```kconfig
menuconfig HAVE_OPERATOR__AI_ONNX__ARGMAX__12
	bool "12"
	help
		Enable domain 'ai.onnx' operator 'ArgMax' version '12'
	default y
	if HAVE_OPERATOR__AI_ONNX__ARGMAX__12
		rsource "*.Kconfig"
	endif
```

## src/operators/ai.onnx/ArgMax/Kconfig
```kconfig
menuconfig HAVE_OPERATOR__AI_ONNX__ARGMAX
	bool "ArgMax"
	default y
	help
		Enable the domain 'ai.onnx' operator 'ArgMax'
	if HAVE_OPERATOR__AI_ONNX__ARGMAX
		rsource "*/Kconfig"
	endif
```

## src/operators/ai.onnx/BatchNormalization/Kconfig
```kconfig
menuconfig HAVE_OPERATOR__AI_ONNX__BATCHNORMALIZATION
	bool "BatchNormalization"
	default y
	help
		Enable the domain 'ai.onnx' operator 'BatchNormalization'
	if HAVE_OPERATOR__AI_ONNX__BATCHNORMALIZATION
		rsource "*/Kconfig"
	endif
```

## src/operators/ai.onnx/Clip/12/Kconfig
```kconfig
menuconfig HAVE_OPERATOR__AI_ONNX__CLIP__12
	bool "12"
	help
		Enable domain 'ai.onnx' operator 'Clip' version '12'
	default y
	if HAVE_OPERATOR__AI_ONNX__CLIP__12
		rsource "*.Kconfig"
	endif
```

## src/operators/ai.onnx/Clip/Kconfig
```kconfig
menuconfig HAVE_OPERATOR__AI_ONNX__CLIP
	bool "Clip"
	default y
	help
		Enable the domain 'ai.onnx' operator 'Clip'
	if HAVE_OPERATOR__AI_ONNX__CLIP
		rsource "*/Kconfig"
	endif
```

## src/operators/ai.onnx/Constant/12/Kconfig
```kconfig
menuconfig HAVE_OPERATOR__AI_ONNX__CONSTANT__12
	bool "12"
	help
		Enable domain 'ai.onnx' operator 'Constant' version '12'
	default y
	if HAVE_OPERATOR__AI_ONNX__CONSTANT__12
		rsource "*.Kconfig"
	endif
```

## src/operators/ai.onnx/Constant/Kconfig
```kconfig
menuconfig HAVE_OPERATOR__AI_ONNX__CONSTANT
	bool "Constant"
	default y
	help
		Enable the domain 'ai.onnx' operator 'Constant'
	if HAVE_OPERATOR__AI_ONNX__CONSTANT
		rsource "*/Kconfig"
	endif
```

## src/operators/ai.onnx/Conv/11/Kconfig
```kconfig
menuconfig HAVE_OPERATOR__AI_ONNX__CONV__11
	bool "11"
	help
		Enable domain 'ai.onnx' operator 'Conv' version '11'
	default y
	if HAVE_OPERATOR__AI_ONNX__CONV__11
		rsource "*.Kconfig"
	endif
```

## src/operators/ai.onnx/Conv/Kconfig
```kconfig
menuconfig HAVE_OPERATOR__AI_ONNX__CONV
	bool "Conv"
	default y
	help
		Enable the domain 'ai.onnx' operator 'Conv'
	if HAVE_OPERATOR__AI_ONNX__CONV
		rsource "*/Kconfig"
	endif
```

## src/operators/ai.onnx/Elu/6/Kconfig
```kconfig
menuconfig HAVE_OPERATOR__AI_ONNX__ELU__6
	bool "6"
	help
		Enable domain 'ai.onnx' operator 'Elu' version '6'
	default y
	if HAVE_OPERATOR__AI_ONNX__ELU__6
		rsource "*.Kconfig"
	endif
```

## src/operators/ai.onnx/Elu/Kconfig
```kconfig
menuconfig HAVE_OPERATOR__AI_ONNX__ELU
	bool "Elu"
	default y
	help
		Enable the domain 'ai.onnx' operator 'Elu'
	if HAVE_OPERATOR__AI_ONNX__ELU
		rsource "*/Kconfig"
	endif
```

## src/operators/ai.onnx/GlobalAveragePool/1/Kconfig
```kconfig
menuconfig HAVE_OPERATOR__AI_ONNX__GLOBALAVERAGEPOOL__1
	bool "1"
	help
		Enable domain 'ai.onnx' operator 'GlobalAveragePool' version '1'
	default y
	if HAVE_OPERATOR__AI_ONNX__GLOBALAVERAGEPOOL__1
		rsource "*.Kconfig"
	endif
```

## src/operators/ai.onnx/GlobalAveragePool/Kconfig
```kconfig
menuconfig HAVE_OPERATOR__AI_ONNX__GLOBALAVERAGEPOOL
	bool "GlobalAveragePool"
	default y
	help
		Enable the domain 'ai.onnx' operator 'GlobalAveragePool'
	if HAVE_OPERATOR__AI_ONNX__GLOBALAVERAGEPOOL
		rsource "*/Kconfig"
	endif
```

## src/operators/ai.onnx/Identity/Kconfig
```kconfig
menuconfig HAVE_OPERATOR__AI_ONNX__IDENTITY
	bool "Identity"
	default y
	help
		Enable the domain 'ai.onnx' operator 'Identity'
	if HAVE_OPERATOR__AI_ONNX__IDENTITY
		rsource "*/Kconfig"
	endif
```

## src/operators/ai.onnx/Kconfig
```kconfig
menuconfig HAVE_DOMAIN__AI_ONNX
	bool "ai.onnx"
	help
		Enable the operator domain 'ai.onnx'
	default y
	if HAVE_DOMAIN__AI_ONNX
		rsource "*/Kconfig"
	endif
```

## src/operators/ai.onnx/LeakyRelu/6/Kconfig
```kconfig
menuconfig HAVE_OPERATOR__AI_ONNX__LEAKYRELU__6
	bool "6"
	help
		Enable domain 'ai.onnx' operator 'LeakyRelu' version '6'
	default y
	if HAVE_OPERATOR__AI_ONNX__LEAKYRELU__6
		rsource "*.Kconfig"
	endif
```

## src/operators/ai.onnx/LeakyRelu/Kconfig
```kconfig
menuconfig HAVE_OPERATOR__AI_ONNX__LEAKYRELU
	bool "LeakyRelu"
	default y
	help
		Enable the domain 'ai.onnx' operator 'LeakyRelu'
	if HAVE_OPERATOR__AI_ONNX__LEAKYRELU
		rsource "*/Kconfig"
	endif
```

## src/operators/ai.onnx/MatMul/9/Kconfig
```kconfig
menuconfig HAVE_OPERATOR__AI_ONNX__MATMUL__9
	bool "9"
	help
		Enable domain 'ai.onnx' operator 'MatMul' version '9'
	default y
	if HAVE_OPERATOR__AI_ONNX__MATMUL__9
		rsource "*.Kconfig"
	endif
```

## src/operators/ai.onnx/MatMul/Kconfig
```kconfig
menuconfig HAVE_OPERATOR__AI_ONNX__MATMUL
	bool "MatMul"
	default y
	help
		Enable the domain 'ai.onnx' operator 'MatMul'
	if HAVE_OPERATOR__AI_ONNX__MATMUL
		rsource "*/Kconfig"
	endif
```

## src/operators/ai.onnx/MaxPool/12/Kconfig
```kconfig
menuconfig HAVE_OPERATOR__AI_ONNX__MAXPOOL__12
	bool "12"
	help
		Enable domain 'ai.onnx' operator 'MaxPool' version '12'
	default y
	if HAVE_OPERATOR__AI_ONNX__MAXPOOL__12
		rsource "*.Kconfig"
	endif
```

## src/operators/ai.onnx/MaxPool/Kconfig
```kconfig
menuconfig HAVE_OPERATOR__AI_ONNX__MAXPOOL
	bool "MaxPool"
	default y
	help
		Enable the domain 'ai.onnx' operator 'MaxPool'
	if HAVE_OPERATOR__AI_ONNX__MAXPOOL
		rsource "*/Kconfig"
	endif
```
