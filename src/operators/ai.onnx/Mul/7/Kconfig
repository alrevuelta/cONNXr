## src/operators/ai.onnx/Mul/7/Kconfig
```kconfig
menuconfig HAVE_OPERATOR__AI_ONNX__MUL__7
	bool "7"
	help
		Enable domain 'ai.onnx' operator 'Mul' version '7'
	default y
	if HAVE_OPERATOR__AI_ONNX__MUL__7
		rsource "*.Kconfig"
	endif
```

## src/operators/ai.onnx/Mul/Kconfig
```kconfig
menuconfig HAVE_OPERATOR__AI_ONNX__MUL
	bool "Mul"
	default y
	help
		Enable the domain 'ai.onnx' operator 'Mul'
	if HAVE_OPERATOR__AI_ONNX__MUL
		rsource "*/Kconfig"
	endif
```

## src/operators/ai.onnx/Relu/6/Kconfig
```kconfig
menuconfig HAVE_OPERATOR__AI_ONNX__RELU__6
	bool "6"
	help
		Enable domain 'ai.onnx' operator 'Relu' version '6'
	default y
	if HAVE_OPERATOR__AI_ONNX__RELU__6
		rsource "*.Kconfig"
	endif
```

## src/operators/ai.onnx/Relu/Kconfig
```kconfig
menuconfig HAVE_OPERATOR__AI_ONNX__RELU
	bool "Relu"
	default y
	help
		Enable the domain 'ai.onnx' operator 'Relu'
	if HAVE_OPERATOR__AI_ONNX__RELU
		rsource "*/Kconfig"
	endif
```

## src/operators/ai.onnx/Reshape/5/Kconfig
```kconfig
menuconfig HAVE_OPERATOR__AI_ONNX__RESHAPE__5
	bool "5"
	help
		Enable domain 'ai.onnx' operator 'Reshape' version '5'
	default y
	if HAVE_OPERATOR__AI_ONNX__RESHAPE__5
		rsource "*.Kconfig"
	endif
```

## src/operators/ai.onnx/Reshape/Kconfig
```kconfig
menuconfig HAVE_OPERATOR__AI_ONNX__RESHAPE
	bool "Reshape"
	default y
	help
		Enable the domain 'ai.onnx' operator 'Reshape'
	if HAVE_OPERATOR__AI_ONNX__RESHAPE
		rsource "*/Kconfig"
	endif
```

## src/operators/ai.onnx/Sigmoid/6/Kconfig
```kconfig
menuconfig HAVE_OPERATOR__AI_ONNX__SIGMOID__6
	bool "6"
	help
		Enable domain 'ai.onnx' operator 'Sigmoid' version '6'
	default y
	if HAVE_OPERATOR__AI_ONNX__SIGMOID__6
		rsource "*.Kconfig"
	endif
```

## src/operators/ai.onnx/Sigmoid/Kconfig
```kconfig
menuconfig HAVE_OPERATOR__AI_ONNX__SIGMOID
	bool "Sigmoid"
	default y
	help
		Enable the domain 'ai.onnx' operator 'Sigmoid'
	if HAVE_OPERATOR__AI_ONNX__SIGMOID
		rsource "*/Kconfig"
	endif
```

## src/operators/ai.onnx/Softmax/11/Kconfig
```kconfig
menuconfig HAVE_OPERATOR__AI_ONNX__SOFTMAX__11
	bool "11"
	help
		Enable domain 'ai.onnx' operator 'Softmax' version '11'
	default y
	if HAVE_OPERATOR__AI_ONNX__SOFTMAX__11
		rsource "*.Kconfig"
	endif
```

## src/operators/ai.onnx/Softmax/Kconfig
```kconfig
menuconfig HAVE_OPERATOR__AI_ONNX__SOFTMAX
	bool "Softmax"
	default y
	help
		Enable the domain 'ai.onnx' operator 'Softmax'
	if HAVE_OPERATOR__AI_ONNX__SOFTMAX
		rsource "*/Kconfig"
	endif
```

## src/operators/ai.onnx/Transpose/1/Kconfig
```kconfig
menuconfig HAVE_OPERATOR__AI_ONNX__TRANSPOSE__1
	bool "1"
	help
		Enable domain 'ai.onnx' operator 'Transpose' version '1'
	default y
	if HAVE_OPERATOR__AI_ONNX__TRANSPOSE__1
		rsource "*.Kconfig"
	endif
```

## src/operators/ai.onnx/Transpose/Kconfig
```kconfig
menuconfig HAVE_OPERATOR__AI_ONNX__TRANSPOSE
	bool "Transpose"
	default y
	help
		Enable the domain 'ai.onnx' operator 'Transpose'
	if HAVE_OPERATOR__AI_ONNX__TRANSPOSE
		rsource "*/Kconfig"
	endif
```
